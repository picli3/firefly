## firmware/c6-zigbee-gateway/main/Kconfig.projbuild
```kconfig
menu "Automatic battery tests"

config AUTO_TEST_ENABLED
    bool "Enable automatic battery test campaigns"
    default y
    help
        Disable after a bench experiment to keep receiving and storing
        telemetry without scheduling further battery discharges.

config AUTO_TEST_FIRST_DELAY_MINUTES
    int "Minutes from gateway boot to first campaign"
    range 1 10080
    default 1
    help
        Relative delay until the first automatic campaign. Use a small value
        during commissioning; without an RTC/NTP source, boot time defines the
        first test time. If no node has reported yet, the gateway retries
        every five seconds until a campaign can start.

config AUTO_TEST_INTERVAL_MINUTES
    int "Minutes between campaigns"
    range 30 10080
    default 60

config AUTO_TEST_GROUP_SIZE
    int "Maximum lamps tested simultaneously"
    range 1 20
    default 10

config AUTO_TEST_DURATION_SECONDS
    int "Battery test duration in seconds"
    range 5 300
    default 300

config AUTO_TEST_GUARD_SECONDS
    int "Pause between groups in seconds"
    range 0 300
    default 15

config AUTO_TEST_LEAD_SECONDS
    int "Preparation time before first group"
    range 5 300
    default 10

endmenu
```

## firmware/c6-zigbee-gateway/sdkconfig.defaults
```kconfig
CONFIG_IDF_TARGET="esp32c6"
CONFIG_ESPTOOLPY_FLASHSIZE_8MB=y
CONFIG_PARTITION_TABLE_CUSTOM=y
CONFIG_PARTITION_TABLE_CUSTOM_FILENAME="partitions.csv"
CONFIG_ZB_ENABLED=y
CONFIG_ESP_CONSOLE_USB_SERIAL_JTAG=y
CONFIG_LOG_DEFAULT_LEVEL_INFO=y
# CONFIG_AUTO_TEST_ENABLED is not set
CONFIG_AUTO_TEST_FIRST_DELAY_MINUTES=1
CONFIG_AUTO_TEST_INTERVAL_MINUTES=60
CONFIG_AUTO_TEST_GROUP_SIZE=10
CONFIG_AUTO_TEST_DURATION_SECONDS=300
CONFIG_AUTO_TEST_GUARD_SECONDS=15
CONFIG_AUTO_TEST_LEAD_SECONDS=10
```

## firmware/h2-coordinator/sdkconfig.defaults
```kconfig
CONFIG_IDF_TARGET="esp32h2"
CONFIG_PARTITION_TABLE_CUSTOM=y
CONFIG_PARTITION_TABLE_CUSTOM_FILENAME="partitions.csv"
CONFIG_ZB_ENABLED=y
CONFIG_ZB_COORDINATOR=y
CONFIG_ESP_CONSOLE_USB_SERIAL_JTAG=y
CONFIG_LOG_DEFAULT_LEVEL_INFO=y
```

## firmware/h2-emergency-light/sdkconfig.defaults
```kconfig
CONFIG_IDF_TARGET="esp32h2"
CONFIG_ESPTOOLPY_FLASHSIZE_4MB=y
CONFIG_SPI_FLASH_SUPPORT_GD_CHIP=y
CONFIG_PARTITION_TABLE_CUSTOM=y
CONFIG_PARTITION_TABLE_CUSTOM_FILENAME="partitions.csv"
CONFIG_ZB_ENABLED=y
CONFIG_ZB_ZED=y
CONFIG_ESP_CONSOLE_USB_SERIAL_JTAG=y
CONFIG_LOG_DEFAULT_LEVEL_INFO=y
```

## firmware/s3-gateway/main/Kconfig.projbuild
```kconfig
menu "Emergency gateway configuration"

config EMERGENCY_WIFI_SSID
    string "Wi-Fi SSID"
    default ""

config EMERGENCY_WIFI_PASSWORD
    string "Wi-Fi password"
    default ""

config EMERGENCY_MQTT_URI
    string "MQTT broker URI"
    default "mqtts://mqtt.example.com:8883"

config EMERGENCY_MQTT_USERNAME
    string "MQTT username"
    default ""

config EMERGENCY_MQTT_PASSWORD
    string "MQTT password"
    default ""

config EMERGENCY_MQTT_TOPIC_PREFIX
    string "MQTT topic prefix"
    default "emergency-lights"

endmenu
```
